
// hold or toggle layer 1   
lower: tap_dance_0 {
    compatible = "zmk,behavior-tap-dance";
    label = "LAYER_TAP_DANCE";
    #binding-cells = <0>;
    tapping-term-ms = <200>;
    bindings = <&mo 1>, <&to 1>;
};

// hold or toggle layer 2
upper: tap_dance_1 {
    compatible = "zmk,behavior-tap-dance";
    label = "UPPER_LAYER_TAP_DANCE";
    #binding-cells = <0>;
    tapping-term-ms = <200>;
    bindings = <&mo 2>, <&to 2>;
};

// hold or toggle layer 2
french: tap_dance_2 {
    compatible = "zmk,behavior-tap-dance";
    label = "UPPER_LAYER_TAP_DANCE";
    #binding-cells = <0>;
    tapping-term-ms = <200>;
    bindings = <&mo 3>, <&to 3>;
};
